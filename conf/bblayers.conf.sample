## conf/bblayers.conf.sample
```bitbake
LCONF_VERSION = "6"

BBPATH = "${TOPDIR}"
BSPDIR := "${@os.path.abspath(os.path.dirname(d.getVar('FILE', True)) + '/../..')}"

BBFILES ?= ""
BBLAYERS = " \
  ${BSPDIR}/sources/poky/meta \
  ${BSPDIR}/sources/poky/meta-yocto \
  \
  ${BSPDIR}/sources/meta-openembedded/meta-oe \
  ${BSPDIR}/sources/meta-openembedded/meta-gnome \
  ${BSPDIR}/sources/meta-openembedded/meta-networking \
  \
  ${BSPDIR}/sources/meta-fsl-arm \
  ${BSPDIR}/sources/meta-fsl-arm-extra \
  ${BSPDIR}/sources/meta-fsl-demos \
  \
  ${BSPDIR}/sources/meta-fsl-bsp-release/imx/meta-fsl-arm \
  ${BSPDIR}/sources/meta-fsl-bsp-release/imx/meta-fsl-demos \
  \
  ${BSPDIR}/sources/meta-browser \
  \
  ${BSPDIR}/sources/meta-via-bsp \
"
```

## conf/layer.conf
```bitbake
# We have a conf and classes directory, add to BBPATH
BBPATH .= ":${LAYERDIR}"

# We have recipes-* directories, add to BBFILES
BBFILES += "${LAYERDIR}/recipes-*/*/*.bb \
	${LAYERDIR}/recipes-*/*/*.bbappend"

BBFILE_COLLECTIONS += "vab820"
BBFILE_PATTERN_vab820 = "^${LAYERDIR}/"
BBFILE_PRIORITY_vab820 = "9"
```

## conf/machine/imx6qvab820.conf
```bitbake
#@TYPE: Machine
#@NAME: VIA VAB-820
#@SOC: i.MX6Q
#@DESCRIPTION: Machine configuration for VAB-820

require conf/machine/include/imx6sabresd-common.inc

SOC_FAMILY = "mx6:mx6q"

KERNEL_DEVICETREE = "imx6q-vab820.dtb imx6dl-vab820.dtb"

UBOOT_CONFIG ??= "sd"
UBOOT_CONFIG[sd] = "mx6qvab820_config,sdcard"
```
